## c/deps/az_mqtt/Kconfig
```kconfig
menu "az_mqtt"

    config AZ_MQTT_ENABLE_MQTTV3
        bool "MQTT 3.1.1 client (az_mqttv3)"
        default y

    config AZ_MQTT_ENABLE_MQTTV5
        bool "MQTT 5.0 client (az_mqttv5)"
        default y

    config AZ_MQTT_ENABLE_PROXY
        bool "HTTP CONNECT proxy support"
        default y

    config AZ_MQTT_ENABLE_WEBSOCKETS
        bool "MQTT over WebSockets"
        default y

    choice AZ_MQTT_TLS_BACKEND
        prompt "TLS backend"
        default AZ_MQTT_TLS_MBEDTLS

        config AZ_MQTT_TLS_MBEDTLS
            bool "mbedTLS"
        config AZ_MQTT_TLS_NONE
            bool "None (plain TCP only)"
    endchoice

    config AZ_MQTT_LOGGING
        bool "Logging (azure-sdk-for-c az_log)"
        default y
        help
            Off defines AZ_NO_LOGGING, which compiles az_mqtt logging out.

    config AZ_MQTT_PRECONDITIONS
        bool "Precondition checks"
        default y
        help
            Off defines AZ_NO_PRECONDITION_CHECKING.

    config AZ_MQTT_BUILD_AZ_CORE
        bool "Build the azure-sdk-for-c sources az_mqtt needs"
        default y
        help
            Compiles az_span.c, az_log.c, az_precondition.c (and az_base64.c with proxy or
            WebSockets) from deps/azure-sdk-for-c. Turn off when another component already
            compiles them, to avoid duplicate symbols.

    config AZ_MQTT_AZ_CORE_COMPONENT
        string "Component that compiles the azure-sdk-for-c sources"
        depends on !AZ_MQTT_BUILD_AZ_CORE
        default ""
        help
            Required. It must also provide the azure-sdk-for-c headers (sdk/inc) as public
            include directories. az_mqtt links to it, so its archive follows az_mqtt's on the
            link line.

endmenu
```

## c/platforms/esp32/components/azure-iot-sdk-az-mqtt/Kconfig
```kconfig
menu "Azure IoT SDK az_mqtt adapter"

    # The adapter builds MQTT 3.1.1 clients.
    config AZ_IOT_AZ_MQTT_ADAPTER
        bool
        default y
        select AZ_MQTT_ENABLE_MQTTV3

    config AZ_IOT_AZ_MQTT_SEND_BUFFER_SIZE
        int "Largest outgoing MQTT packet (bytes)"
        range 1024 268435455
        default 8192
        help
            az_iot_mqtt_limits.send_buffer_size of the samples, which also size their
            message store for one copy for QoS 1 redelivery. Must hold the largest
            telemetry message.

    config AZ_IOT_AZ_MQTT_RECEIVE_BUFFER_SIZE
        int "Largest incoming MQTT packet (bytes)"
        range 1024 268435455
        default 12288
        help
            az_iot_mqtt_limits.receive_buffer_size of the samples. Each client holds it
            twice (packet and inbound strings). Must hold the largest incoming message
            (a twin document, say) plus its topic and envelope.

    config AZ_IOT_AZ_MQTT_INFLIGHT_MAX
        int "Requests in flight at once"
        range 1 32767
        default 8
        help
            az_iot_mqtt_limits.max_in_flight_messages of the samples.

endmenu
```

## c/samples/adu/esp32/main/Kconfig.projbuild
```kconfig
menu "ADU ESP32 Sample Configuration"

    config ADU_WIFI_SSID
        string "Wi-Fi SSID"
        default "my-ssid"
        help
            SSID of the Wi-Fi network the device joins to reach Azure.

    config ADU_WIFI_PASSWORD
        string "Wi-Fi password"
        default "my-password"
        help
            WPA2 password for the configured Wi-Fi network.

    config ADU_DPS_ID_SCOPE
        string "DPS ID scope"
        default "0ne00000000"
        help
            Device Provisioning Service ID scope (AZ_IOT_DPS_ID_SCOPE from the
            Initialize-AduSampleEnvironment.ps1 output).

    config ADU_DPS_REGISTRATION_ID
        string "DPS registration id (device id)"
        default "adu-esp32-device"
        help
            DPS registration id. Must match the CN of the embedded device
            certificate and the X.509 enrollment created by the init script.

endmenu
```

## c/samples/software_update/esp32/main/Kconfig.projbuild
```kconfig
menu "Software Updates ESP32 Sample Configuration"

    config SU_DPS_ID_SCOPE
        string "DPS ID scope"
        default "0ne00000000"
        help
            Device Provisioning Service ID scope.

    config SU_DPS_REGISTRATION_ID
        string "DPS registration id (device id)"
        default "su-esp32-device"
        help
            DPS registration id. Must match the CN of the embedded device
            certificate and the device's X.509 enrollment.

    config SU_POLL_INTERVAL_S
        int "Update check interval (seconds)"
        range 10 86400
        default 14400
        help
            Seconds between update checks on the regular route, once the
            device has connected to its hub. Checks are skipped while a
            deployment is in flight. A check not answered within half
            the interval (at most 60 s) is abandoned. Checks and reports
            from all devices share the provisioning service's request
            budget, which plans for one check per device every 4 hours.

endmenu
```

## c/samples/su/esp32/main/Kconfig.projbuild
```kconfig
menu "Software Updates ESP32 Sample Configuration"

    config SU_WIFI_SSID
        string "Wi-Fi SSID"
        default "my-ssid"
        help
            SSID of the Wi-Fi network the device joins to reach Azure.

    config SU_WIFI_PASSWORD
        string "Wi-Fi password"
        default "my-password"
        help
            WPA2 password for the configured Wi-Fi network.

    config SU_DPS_ID_SCOPE
        string "DPS ID scope"
        default "0ne00000000"
        help
            Device Provisioning Service ID scope (AZ_IOT_DPS_ID_SCOPE from the
            Initialize-SuSampleEnvironment.ps1 output).

    config SU_DPS_REGISTRATION_ID
        string "DPS registration id (device id)"
        default "su-esp32-device"
        help
            DPS registration id. Must match the CN of the embedded device
            certificate and the X.509 enrollment created by the init script.

endmenu
```

## c/samples/unified/esp32/main/Kconfig.projbuild
```kconfig
menu "IoT Hub ESP32 Sample Configuration"

    config HUB_DPS_ID_SCOPE
        string "DPS ID scope"
        default "0ne00000000"
        help
            Device Provisioning Service ID scope.

    config HUB_DPS_REGISTRATION_ID
        string "DPS registration id (device id)"
        default "hub-esp32-device"
        help
            DPS registration id. Must match the CN of the device certificate in the
            esp_secure_cert partition and the device's X.509 enrollment.

    config HUB_DPS_GLOBAL_ENDPOINT
        string "DPS global endpoint"
        default ""
        help
            DPS global device endpoint host name. Empty: global.azure-devices-provisioning.net.

    config HUB_TELEMETRY_INTERVAL_S
        int "Telemetry interval (seconds)"
        range 1 86400
        default 10
        help
            Seconds between two telemetry messages while connected to the hub.

endmenu
```
